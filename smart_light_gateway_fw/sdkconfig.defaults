## smart_light_gateway_fw/sdkconfig.defaults
```kconfig
CONFIG_ESPTOOLPY_FLASHSIZE_16MB=y
CONFIG_ESPTOOLPY_FLASHSIZE="16MB"
CONFIG_PARTITION_TABLE_CUSTOM=y
CONFIG_PARTITION_TABLE_CUSTOM_FILENAME="partitions.csv"
CONFIG_PARTITION_TABLE_FILENAME="partitions.csv"
CONFIG_PARTITION_TABLE_OFFSET=0x8000
CONFIG_PARTITION_TABLE_MD5=y

CONFIG_ESP_SYSTEM_EVENT_QUEUE_SIZE=32
CONFIG_ESP_SYSTEM_EVENT_TASK_STACK_SIZE=5120

CONFIG_MBEDTLS_DHM_C=y
CONFIG_MBEDTLS_ECDH_C=y

CONFIG_BT_ENABLED=y
CONFIG_BT_BLE_42_FEATURES_SUPPORTED=y
CONFIG_BLE_MESH=y
CONFIG_BT_BLE_BLUFI_ENABLE=y
CONFIG_BLE_MESH_NODE=y
CONFIG_BLE_MESH_PB_ADV=y
CONFIG_BLE_MESH_PB_GATT=y
CONFIG_BLE_MESH_RELAY=y
CONFIG_BLE_MESH_RELAY_ADV_BUF=y
CONFIG_BLE_MESH_FRIEND=y
CONFIG_BLE_MESH_HEALTH_SRV=y
CONFIG_BLE_MESH_GENERIC_ONOFF_CLI=y
CONFIG_BLE_MESH_GENERIC_SERVER=y

CONFIG_BLE_MESH_SETTINGS=y
CONFIG_BLE_MESH_STORE_TIMEOUT=0
CONFIG_BLE_MESH_SEQ_STORE_RATE=0
CONFIG_BLE_MESH_RPL_STORE_TIMEOUT=0

CONFIG_BT_GATTS_SEND_SERVICE_CHANGE_MANUAL=y
# CONFIG_BT_GATTS_SEND_SERVICE_CHANGE_AUTO is not set
CONFIG_BT_GATTS_SEND_SERVICE_CHANGE_MODE=1

CONFIG_CONSOLE_SORTED_HELP=y

CONFIG_ESP_CONSOLE_USB_SERIAL_JTAG=y
CONFIG_ESP_CONSOLE_UART_NUM=-1
```

## smart_light_node_fw/components/device_identity/Kconfig
```kconfig
menu "Device Identity Configuration"

config DEVICE_TYPE
    string "Device type"
    default 3017
    help
      Loại công tắc.

config SOFTWARE_VERSION
    string "Software Version"
    default "2.2.0"
    help
      Phiên bản phần mềm firmware.

endmenu
```

## smart_light_node_fw/sdkconfig.defaults
```kconfig
CONFIG_ESPTOOLPY_FLASHSIZE_4MB=y
CONFIG_ESPTOOLPY_FLASHSIZE="4MB"
CONFIG_PARTITION_TABLE_CUSTOM=y
CONFIG_PARTITION_TABLE_CUSTOM_FILENAME="partitions.csv"
CONFIG_PARTITION_TABLE_FILENAME="partitions.csv"
CONFIG_PARTITION_TABLE_OFFSET=0x8000
CONFIG_PARTITION_TABLE_MD5=y

CONFIG_BT_ENABLED=y
CONFIG_BT_BLE_42_FEATURES_SUPPORTED=y
CONFIG_BLE_MESH=y
CONFIG_BLE_MESH_NODE=y
CONFIG_BLE_MESH_PB_ADV=y
CONFIG_BLE_MESH_PB_GATT=y
CONFIG_BLE_MESH_RELAY=y
CONFIG_BLE_MESH_RELAY_ADV_BUF=y
CONFIG_BLE_MESH_FRIEND=y
CONFIG_BLE_MESH_HEALTH_SRV=y
CONFIG_BLE_MESH_GENERIC_ONOFF_CLI=y
CONFIG_BLE_MESH_GENERIC_SERVER=y

CONFIG_BLE_MESH_SETTINGS=y
CONFIG_BLE_MESH_STORE_TIMEOUT=0
CONFIG_BLE_MESH_SEQ_STORE_RATE=0
CONFIG_BLE_MESH_RPL_STORE_TIMEOUT=0

CONFIG_CONSOLE_SORTED_HELP=y
```
